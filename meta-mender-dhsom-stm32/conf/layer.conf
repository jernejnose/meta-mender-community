## meta-mender-dhsom-stm32/conf/layer.conf
```bitbake
# We have a conf and classes directory, add to BBPATH
BBPATH .= ":${LAYERDIR}"

# We have recipes-* directories, add to BBFILES
BBFILES += "${LAYERDIR}/recipes-*/*/*.bb \
	${LAYERDIR}/recipes-*/*/*.bbappend"

BBFILE_COLLECTIONS += "mender-community-dhsom-stm32"
BBFILE_PATTERN_mender-community-dhsom-stm32 = "^${LAYERDIR}/"
BBFILE_PRIORITY_mender-community-dhsom-stm32 = "5"
LAYERSERIES_COMPAT_mender-community-dhsom-stm32 = "kirkstone"
```
